/*
*
* Copyright (c) 2024 The ZMK Contributors
* SPDX-License-Identifier: MIT
*
*/

#include "eyelash_corne.dtsi"
#include "eyelash_corne_compatibility.dtsi"


&default_transform {
    col-offset = <7>;
};
